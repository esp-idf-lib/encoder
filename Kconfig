## Kconfig
```kconfig
menu "Rotary encoders"

	config RE_INTERVAL_US
		int "Default polling interval, us"
		default 10000 if IDF_TARGET_ESP8266
		default 1000 if !IDF_TARGET_ESP8266
		help
		    Default polling interval in microseconds. Can be overridden per-encoder at runtime
		    via rotary_encoder_config_t.polling_interval_us.

	config RE_BTN_DEAD_TIME_US
		int "Default button dead time, us"
		default 10000
		help
		    Default button dead time in microseconds. Can be overridden per-encoder at runtime
		    via rotary_encoder_config_t.btn_dead_time_us.

	choice RE_BTN_PRESSED_LEVEL
		prompt "Default logical level on pressed button"
		help
		    Default GPIO level when button is pressed. Can be overridden per-encoder at runtime
		    via rotary_encoder_config_t.btn_pressed_level.
		config RE_BTN_PRESSED_LEVEL_0
			bool "0"
		config RE_BTN_PRESSED_LEVEL_1
			bool "1"
	endchoice

	config RE_BTN_LONG_PRESS_TIME_US
		int "Default long press timeout, us"
		default 500000
		help
		    Default long press threshold in microseconds. Can be overridden per-encoder at runtime
		    via rotary_encoder_config_t.btn_long_press_time_us.

	config RE_ACCELERATION_THRESHOLD
		int "Default acceleration threshold (ms)"
		default 200
		help
		    Acceleration threshold in milliseconds. When the interval between rotary ticks is below
		    this value, acceleration is applied. Can be overridden per-encoder at runtime
		    via rotary_encoder_config_t.acceleration_threshold_ms.

	config RE_ACCELERATION_CAP
		int "Default acceleration cap (ms)"
		default 4
		help
		    Acceleration cap in milliseconds. The minimum tick interval used for acceleration
		    calculation, limiting the maximum acceleration effect. Can be overridden per-encoder
		    at runtime via rotary_encoder_config_t.acceleration_cap_ms.
endmenu
```

## examples/default/main/Kconfig.projbuild
```kconfig
menu "Example configuration"

    config EXAMPLE_RE_A_GPIO
        int "GPIO number of the encoder pin A"
        range 0 54
        default 16
        help
            The GPIO connected to the pin A of the encoder. The encoder has no
            direction, so the pins A and B can be swapped, but they must differ.

    config EXAMPLE_RE_B_GPIO
        int "GPIO number of the encoder pin B"
        range 0 54
        default 17
        help
            The GPIO connected to the pin B of the encoder. The pins A and B
            must differ.

    config EXAMPLE_RE_BTN_GPIO
        int "GPIO number of the encoder button"
        range -1 54
        default 18
        help
            The GPIO connected to the push button of the encoder, if any. The
            driver reads the button as active low, so connect the other side of
            the button to ground.

            Set to -1 if the encoder has no button.

endmenu
```
